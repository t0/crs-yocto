## meta-t0-crs/conf/layer.conf
```bitbake
# We have a conf and classes directory, add to BBPATH
BBPATH .= ":${LAYERDIR}"

# We have recipes-* directories, add to BBFILES
BBFILES += "${LAYERDIR}/recipes-*/*/*.bb \
            ${LAYERDIR}/recipes-*/*/*.bbappend"

BBFILE_COLLECTIONS += "meta-t0-crs"
BBFILE_PATTERN_meta-t0-crs = "^${LAYERDIR}/"
BBFILE_PRIORITY_meta-t0-crs = "6"

LAYERDEPENDS_meta-t0-crs = "core"
LAYERSERIES_COMPAT_meta-t0-crs = "scarthgap"
```

## meta-t0-crs/wic/t0-crs-sd.wks
```
# Description: Creates a partitioned SD card image. Boot files
# are located in the first vfat partition. Rootfs will be in second ext4 partition.
# /home is provisioned on first boot (crs-home-reprovision.service).

part  /boot  --source rootfs --change-directory=boot  --fixed-size=128M  --fstype=vfat  --use-label  --label boot  --active  --align 4
part  /      --source rootfs --exclude-path=boot/                        --fstype=ext4  --use-label  --label root            --align 4
```
